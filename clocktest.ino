#include <Wire.h>
#include <Adafruit_GFX.h>
#include <Adafruit_SSD1306.h>
#include <RTClib.h>
#include "MyGPS.h"

#define SCREEN_WIDTH 128 // OLED display width, in pixels
#define SCREEN_HEIGHT 64 // OLED display height, in pixels

// Declaration for an SSD1306 display connected to I2C (SDA, SCL pins)
#define OLED_RESET     -1 // Reset pin # (or -1 if sharing Arduino reset pin)
Adafruit_SSD1306 display1(SCREEN_WIDTH, SCREEN_HEIGHT, &Wire, OLED_RESET);
Adafruit_SSD1306 display2(SCREEN_WIDTH, SCREEN_HEIGHT, &Wire, OLED_RESET);

#define PUPIL_RADIUS 28
static const unsigned char PROGMEM eye_bmp[] = { B00000000,B00000000,B00000000,B00000000,B00000000,B00000000,B00000000,B00000011,B10000000,B00000000,B00000000,B00000000,B00000000,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B00000000,B00000000 };
static const unsigned char PROGMEM spanner_bmp[] = { B00000000,B00000000,B00000000,B00000001,B11100000,B00000000,B00000000,B00000000,B00000000,B00000111,B11100000,B00000000,B00000000,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B00000000,B00000000 };
static const unsigned char PROGMEM mug_bmp[] = { B00000000,B00000000,B00000000,B00000000,B00000000,B00000000,B00000000,B00000000,B00000000,B00000000,B00000000,B00000000,B00000000,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B00000000,B00000000 };

unsigned long gpsDate, gpsTime, gpsFixAge;

const char* months[] = {
  "Jan",
  "Feb",
  "Mar",
  "Apr",
  "May",
  "Jun",
  "Jul",
  "Aug",
  "Sep",
  "Oct",
  "Nov",
  "Dec"
};

MyGPS gps;

DS1307 rtc;

void setup() {
  Serial.begin(115200);
  Serial3.begin(9600);

  if(!display1.begin(SSD1306_SWITCHCAPVCC, 0x3C)) {
    Serial.println(F("SSD1306 nr1 allocation failed"));
    for(;;); // Don't proceed, loop forever
  }
  if(!display2.begin(SSD1306_SWITCHCAPVCC, 0x3D)) {
    Serial.println(F("SSD1306 nr2 allocation failed"));
    for(;;); // Don't proceed, loop forever
  }

  display1.setTextColor(WHITE);
  display2.setTextColor(WHITE);
  display1.clearDisplay();
  display2.clearDisplay();
  display1.setTextSize(2);
  display1.setCursor(0, 0);
  display2.setTextSize(2);
  display2.setCursor(0, 0);
  display1.print("Built By\nJeremy\nClockson");
  display2.print("Assist By\nThe Great\nWizzard");
  display1.display();
  display2.display();
  delay(3000);

  rtc.begin();
  if (!rtc.isrunning()) {
    Serial.println("RTC is NOT running!");

    display1.clearDisplay();
    display2.clearDisplay();
    display1.setTextSize(4);
    display1.setCursor(0, 0);
    display2.setTextSize(4);
    display2.setCursor(0, 0);
    display1.print("Seek");
    display2.print("GPS");
    display1.display();
    display2.display();
    
    while(!service_gps()){}   
  }
  
  
}

void draw_eyes(int xOffset){
  display1.clearDisplay();
  display2.clearDisplay();
  display1.drawBitmap(0, 0, eye_bmp, SCREEN_WIDTH, SCREEN_HEIGHT, 1);
  display1.fillCircle((SCREEN_WIDTH / 2) + xOffset, SCREEN_HEIGHT / 2, PUPIL_RADIUS, 0);
  display2.drawBitmap(0, 0, eye_bmp, SCREEN_WIDTH, SCREEN_HEIGHT, 1);
  display2.fillCircle((SCREEN_WIDTH / 2) + xOffset, SCREEN_HEIGHT / 2, PUPIL_RADIUS, 0);
  display1.display();
  display2.display();
}
bool is_dst(const DateTime& now){
  int month = now.month();
  if (month < 3 || month > 10) { return false; }
  if (month > 3 && month < 10) { return true; }
  int dow = now.dayOfWeek();
  int lastSunday = now.day() - dow;
  if(month == 3){ return lastSunday >= 25 && now.hour() >= 1; }
  return lastSunday < 24 || (dow == 0 && now.hour() < 2);
}
void render_time(const DateTime& now){  
  char buffer[20];
  display1.setTextSize(4);
  display1.clearDisplay();
  int16_t x, y;
  uint16_t w, h;
  sprintf(buffer, "%02d%s%02d", now.hour(), now.second() % 2 ? ":" : " ", now.minute());
  display1.getTextBounds(buffer, 0, 0, &x, &y, &w, &h);
  display1.setCursor((SCREEN_WIDTH - w) / 2, (SCREEN_HEIGHT - h) /2);
  display1.print(buffer);
  int lineW = (((float)now.second())/60) * SCREEN_WIDTH;
  for(int i = 1; i <= 2; i++){
    display1.drawLine(0, SCREEN_HEIGHT - i, lineW, SCREEN_HEIGHT - i, WHITE);
  }
  display1.display();
}
void render_date(const DateTime& now){
  char buffer[20];
  int16_t x, y;
  uint16_t w, h;
  display2.clearDisplay();
  display2.setTextSize(4);
  sprintf(buffer, "%02d", now.day());
  display2.getTextBounds(buffer, 0, 0, &x, &y, &w, &h);
  int dayY = ((SCREEN_HEIGHT - h) / 2);
  display2.setCursor(0, dayY - 2);
  display2.print(buffer);
  for(int i = 0; i <= 1; i++){
    display2.drawLine(0, dayY + h + i, w - 4, dayY + h + i, WHITE);
  }
  int monthX = w;

  sprintf(buffer, "%04d", now.year());

  display2.setTextSize(2);
  const char* month = months[now.month() - 1];
  display2.getTextBounds(month, monthX, 0, &x, &y, &w, &h);
  int monthHeight = h;
  int monthWidth = w;
  display2.setTextSize(3);
  display2.getTextBounds(buffer, monthX, 0, &x, &y, &w, &h);
  int rightHeight = h + monthHeight;
  int monthY = (SCREEN_HEIGHT - rightHeight) / 2;
  int yearY = monthY + monthHeight;
  display2.setTextSize(2);
  display2.setCursor(SCREEN_WIDTH - monthWidth, monthY);
  display2.print(month);
  display2.setTextSize(3);
  display2.setCursor(SCREEN_WIDTH - w, yearY);
  display2.print(buffer);
  display2.display();
  
}

void render_cuckoo(const DateTime& now){  
  display1.setTextSize(2);
  display2.setTextSize(2);
  display1.clearDisplay();
  display2.clearDisplay();
  display1.setCursor(0, 0);
  display2.setCursor(0, 0);

  if(now.second() % 3 < 2){
    display1.print("Speaker\nNot\nInstalled");
    display2.print("Please\nShout\nCuckoo!");
  }
  display1.display();
  display2.display();
}

unsigned long eyes_start = 0;
void render_eyes(const DateTime& now){
  unsigned long elapsedMillis = millis() - eyes_start;
  float animPct = ((float)elapsedMillis) / 15000;
  int offset = 0;
  if(animPct < 2){
    offset = (16 * sin(PI * animPct));
  }
  draw_eyes(offset);
}

void render_elevenses(const DateTime& now){
  display2.setTextSize(2);
  display2.clearDisplay();
  display2.setCursor(0, 0);
  display2.print("Time\nfor a\ncuppa!");
  display2.drawBitmap(80, 8, mug_bmp, 48, 48, 1);
  display2.display();
}

void render_workshop(const DateTime& now){
  display2.setTextSize(2);
  display2.clearDisplay();
  display2.setCursor(0, 0);
  display2.print("Workshop\nTime!");
  display2.drawBitmap(80, 16, spanner_bmp, 48, 48, 1);
  display2.display();
}

float easeInOutCubic(float x) {
  return x < 0.5 ? 4 * x * x * x : 1 - pow(-2 * x + 2, 3) / 2;
}

#define ANIM_FRAMES 20
#define ANIM_FRAME_DELAY 50
#define ANIM_MAX_X 16

void loop() {
  DateTime now = rtc.now();
  if(is_dst(now)){
    now = now + 3600;
  }

  if(now.minute() == 0 && now.second() < 36){
    if(now.hour() == 0){
      render_cuckoo(now);
    } else if(now.hour() == 11){
      render_time(now);
      render_elevenses(now);
    } else {
      render_eyes(now);
    }
  } else if(now.hour() == 9 && now.minute() == 30 && now.second() < 36){
    render_time(now);
    render_workshop(now);
  } else {
    eyes_start = millis();
    render_time(now);
    render_date(now);
  }

  service_gps();
}
bool service_gps(){
  bool updated_clock = false;
  while(Serial3.available()){
    int c = Serial3.read();
    if(gps.encode(c))
    {  
      gps.get_datetime(&gpsDate, &gpsTime, &gpsFixAge);
      if(gpsDate && gpsTime){
        DateTime now(gpsDate % 100, (gpsDate / 100) % 100, gpsDate / 10000, gpsTime / 1000000, (gpsTime / 10000) % 100, (gpsTime / 100) % 100);
        char buffer[] = {'h','h',':','m','m',':','s','s',' ','D','D','/','M','M','/','Y','Y',0};
        now.format(buffer);
        Serial.print("Corrected RTC from GPS at ");
        Serial.println(buffer);
        rtc.adjust(now);
        updated_clock = true;
      }
    }
  }
  return updated_clock;
}
